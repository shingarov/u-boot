## arch/arm/mach-aspeed/ast2600/Kconfig
```kconfig
if ASPEED_AST2600

config SYS_CPU
	default "armv7"

config TARGET_EVB_AST2600
	bool "EVB-AST2600"
	help
	  EVB-AST2600 is an ASPEED evaluation board for AST2600 chip.

source "board/aspeed/evb_ast2600/Kconfig"

endif
```

## board/aspeed/ast2300/Kconfig
```kconfig
if TARGET_AST2300

config SYS_BOARD
	default "ast2300"

config SYS_VENDOR
	default "aspeed"

config SYS_SOC
	default "aspeed"

config SYS_CONFIG_NAME
	default "ast2300"

endif
```

## board/aspeed/palmetto/Kconfig
```kconfig
if TARGET_PALMETTO

config SYS_CPU
	default "arm926ejs"

config SYS_BOARD
	default "ast2400"

config SYS_VENDOR
	default "aspeed"

config SYS_SOC
	default "aspeed"

config SYS_CONFIG_NAME
	default "palmetto"

endif
```

## configs/evb-ast2600_defconfig
```kconfig
CONFIG_ARM=y
CONFIG_SYS_DCACHE_OFF=y
CONFIG_ARCH_ASPEED=y
CONFIG_SYS_TEXT_BASE=0x10000
CONFIG_ASPEED_AST2600=y
CONFIG_TARGET_EVB_AST2600=y
CONFIG_SPL_LIBCOMMON_SUPPORT=y
CONFIG_SPL_LIBGENERIC_SUPPORT=y
CONFIG_SYS_MALLOC_F_LEN=0x800
CONFIG_NR_DRAM_BANKS=1
CONFIG_ENV_SIZE=0x10000
CONFIG_SPL_SERIAL_SUPPORT=y
CONFIG_SPL_SIZE_LIMIT=0x10000
CONFIG_SPL=y
# CONFIG_ARMV7_NONSEC is not set
CONFIG_DEFAULT_DEVICE_TREE="ast2600-evb"
CONFIG_DISTRO_DEFAULTS=y
# CONFIG_SYS_MALLOC_CLEAR_ON_INIT is not set
CONFIG_FIT=y
CONFIG_FIT_ENABLE_SHA512_SUPPORT=y
CONFIG_FIT_SIGNATURE=y
CONFIG_USE_BOOTARGS=y
CONFIG_BOOTARGS="console=ttyS4,115200n8 root=/dev/ram rw"
CONFIG_BOOTCOMMAND="bootm 20100000"
# CONFIG_DISPLAY_CPUINFO is not set
CONFIG_SPL_SIZE_LIMIT_SUBTRACT_GD=y
CONFIG_SPL_SIZE_LIMIT_SUBTRACT_MALLOC=y
# CONFIG_SPL_LEGACY_IMAGE_SUPPORT is not set
CONFIG_SPL_SYS_MALLOC_SIMPLE=y
CONFIG_SPL_DM_RESET=y
CONFIG_SPL_RAM_SUPPORT=y
CONFIG_SPL_RAM_DEVICE=y
CONFIG_CMD_I2C=y
CONFIG_CMD_MMC=y
# CONFIG_ISO_PARTITION is not set
# CONFIG_SPL_EFI_PARTITION is not set
CONFIG_PARTITION_TYPE_GUID=y
CONFIG_SPL_OF_CONTROL=y
CONFIG_ENV_OVERWRITE=y
CONFIG_SYS_RELOC_GD_ENV_ADDR=y
CONFIG_NET_RANDOM_ETHADDR=y
CONFIG_SPL_DM=y
CONFIG_SPL_DM_SEQ_ALIAS=y
CONFIG_REGMAP=y
CONFIG_SPL_OF_TRANSLATE=y
CONFIG_CLK=y
CONFIG_SPL_CLK=y
CONFIG_DM_I2C=y
CONFIG_MISC=y
CONFIG_SPL_MISC=y
CONFIG_DM_MMC=y
CONFIG_MMC_SDHCI=y
CONFIG_MMC_SDHCI_ASPEED=y
CONFIG_PHY_REALTEK=y
CONFIG_DM_ETH=y
CONFIG_FTGMAC100=y
CONFIG_PHY=y
CONFIG_PINCTRL=y
CONFIG_RAM=y
CONFIG_SPL_RAM=y
CONFIG_DM_RESET=y
CONFIG_DM_SERIAL=y
CONFIG_SYS_NS16550=y
CONFIG_SYSRESET=y
CONFIG_SPL_SYSRESET=y
CONFIG_WDT=y
CONFIG_SHA512_ALGO=y
CONFIG_HEXDUMP=y
# CONFIG_SPL_HEXDUMP is not set
# CONFIG_EFI_LOADER is not set
```

## configs/palmetto_defconfig
```kconfig
CONFIG_ARM=y
CONFIG_TARGET_PALMETTO=y
# CONFIG_CMD_IMLS is not set
# CONFIG_CMD_FLASH is not set
# CONFIG_CMD_FPGA is not set
# CONFIG_CMD_SETEXPR is not set
CONFIG_SPI_FLASH=y
#CONFIG_SPI_FLASH_ATMEL=y
#CONFIG_SPI_FLASH_MACRONIX=y
CONFIG_SYS_NS16550=y
CONFIG_SYS_PROMPT="boot# "
CONFIG_LIB_RAND=y
```

## drivers/crypto/Kconfig
```kconfig
menu "Hardware crypto devices"

source drivers/crypto/fsl/Kconfig

config ASPEED_HACE
	bool "ASPEED Hash and Crypto Engine"
	select SHA_HW_ACCEL
	select SHA_PROG_HW_ACCEL
	depends on ASPEED_AST2600
	help
	 Select this option to enable a driver for using the SHA engine in
	 the ASPEED BMC SoCs.

	 Enabling this allows the use of SHA operations in hardware without requiring the
	 SHA software implementations, saving code size.

	 Due to hardware limitations it cannot be used with a FIT placed in SPI
	 FLASH. Data can only be hashed if it is in SDRAM, making this relevant
	 for MMC and network boot only.

endmenu
```

## drivers/ram/aspeed/Kconfig
```kconfig
menuconfig ASPEED_RAM
	bool "ASPEED SDRAM Options"
	# This should be replaced with ARCH_ASPEED if/when the ast2500 driver
	# supports kconfig options
	depends on ASPEED_AST2600
	default ASPEED_AST2600
	select RAM

if ASPEED_RAM

choice
	prompt "DDR4 target data rate"
	default ASPEED_DDR4_1600

config ASPEED_DDR4_400
        bool "DDR4 targets at 400Mbps"
        help
          Select DDR4 target data rate at 400M

config ASPEED_DDR4_800
        bool "DDR4 targets at 800Mbps"
        help
          Select DDR4 target data rate at 800M

config ASPEED_DDR4_1600
        bool "DDR4 targets at 1600Mbps"
        help
          Select DDR4 target data rate at 1600M

endchoice

config ASPEED_DDR4_DUALX8
        bool "Dual X8 DDR4 die"
        help
          Select dual X8 DDR4 die

config ASPEED_PALLADIUM
	bool "ASPEED palladium RAM model"
	help
	  This provides configurations specific for Aspeed Palladium SDRAM
	  model

config ASPEED_ECC
        bool "ASPEED SDRAM ECC"
        help
          Enable SDRAM error correcting code function

config ASPEED_VIDEO_SIZE
	int "Video memory reserved size"
	depends on ASPEED_ECC
	default 40
	help
	  Reserved size for Video engine. The unit is in Megabytes.

config ASPEED_CRT_SIZE
	int "CRT memory reserved size"
	depends on ASPEED_ECC
	default 8
	help
	  Reserved size for CRT engine. The unit is in Megabytes.

endif
```
